## CMakeLists.txt
```
# SPDX-License-Identifier: Apache-2.0

cmake_minimum_required(VERSION 3.20.0)

find_package(Zephyr REQUIRED HINTS $ENV{ZEPHYR_BASE})
project(katja)

target_include_directories(app PRIVATE include)
target_sources(app PRIVATE
  src/main.c
  src/ambience.c
  src/conserve.c
  src/illuminate.c
  src/persevere.c
  )
```

## prj.conf
```kconfig
CONFIG_ADC=y
CONFIG_LED=y
#CONFIG_BT=y
CONFIG_GPIO=y
CONFIG_GPIO_HOGS=y
CONFIG_POWEROFF=y
CONFIG_SPI=y
CONFIG_LED_STRIP=y
CONFIG_WS2812_STRIP=y
CONFIG_WS2812_STRIP_SPI=y
CONFIG_CHARGER=y
CONFIG_COUNTER=y
CONFIG_COUNTER_SAM_RTT=y
CONFIG_CHARGER_BQ2407X=y
CONFIG_ZBUS=y
CONFIG_MAIN_STACK_SIZE=2048
CONFIG_CONSOLE=y
CONFIG_SYSTEM_WORKQUEUE_STACK_SIZE=4096

# Debugging
#CONFIG_LOG=y
#CONFIG_MODEM_MODULES_LOG_LEVEL_DBG=y
#CONFIG_ADC_LOG_LEVEL_DBG=y
#CONFIG_STACK_SENTINEL=y
#CONFIG_STACK_CANARIES=y
#CONFIG_LOG_BUFFER_SIZE=16000
#CONFIG_THREAD_ANALYZER_USE_PRINTK=y
#CONFIG_THREAD_ANALYZER=y
#CONFIG_THREAD_NAME=y
#CONFIG_THREAD_ANALYZER_AUTO=y
#CONFIG_THREAD_ANALYZER_AUTO_INTERVAL=5

# Accelerometer
CONFIG_SENSOR=y
CONFIG_I2C=y
CONFIG_SENSOR_LIS2DH12=y

# Networking
CONFIG_NETWORKING=y
CONFIG_MODEM_CELLULAR_APN="trackunit.m2m"
CONFIG_NET_UDP=y
CONFIG_NET_IPV4=y
CONFIG_NET_SOCKETS=y
CONFIG_NET_MGMT=y
CONFIG_NET_MGMT_EVENT=y
CONFIG_NET_CONNECTION_MANAGER=y

# Power management
CONFIG_PM=y
CONFIG_PM_DEVICE=y
CONFIG_PM_DEVICE_RUNTIME=y
CONFIG_POWER_DOMAIN=y

# Watchdog
CONFIG_WATCHDOG=y

# Retained memory
CONFIG_RETAINED_MEM=y

# Management
CONFIG_FLASH=y
CONFIG_FLASH_MAP=y
CONFIG_NET_BUF=y
CONFIG_ZCBOR=y
CONFIG_CRC=y
CONFIG_MCUMGR=y
CONFIG_STREAM_FLASH=y
CONFIG_IMG_MANAGER=y
CONFIG_MCUMGR_GRP_IMG=y
CONFIG_MCUMGR_GRP_OS=y
CONFIG_MCUMGR_GRP_STAT=y
CONFIG_MCUMGR_TRANSPORT_UDP=y
CONFIG_MCUMGR_TRANSPORT_UDP_IPV4=y
CONFIG_MCUMGR_TRANSPORT_UDP_IPV6=y
CONFIG_MCUMGR_TRANSPORT_UDP_AUTOMATIC_INIT=y
```

## src/main.c
```c
#include <zephyr/kernel.h>
#include <zephyr/drivers/watchdog.h>

static const struct device *wdt = DEVICE_DT_GET(DT_ALIAS(watchdog));

int main(void)
{
	while (true) {
		wdt_feed(wdt, 0);
		k_msleep(300);
	}

	return 0;
}
```

## src/agility.c
```c
#include <katja/agility.h>
#include <zephyr/kernel.h>
#include <zephyr/device.h>
#include <zephyr/drivers/sensor.h>
#include <zephyr/drivers/retained_mem.h>
#include <zephyr/pm/device_runtime.h>

#define AGILITY_MOTION_TIMEOUT (K_MSEC(500))
#define AGILITY_MOTION_FILTER  (10)

const struct device *accelerometer = DEVICE_DT_GET(DT_ALIAS(acc));
const struct device *retmem = DEVICE_DT_GET(DT_ALIAS(retmem));

ZBUS_SUBSCRIBER_DEFINE(agility_subscriber, 4);

static const struct sensor_trigger motion_trigger = {
	.type = SENSOR_TRIG_MOTION,
	.chan = SENSOR_CHAN_ACCEL_XYZ,
};

static K_SEM_DEFINE(motion, 0, 1);

static void agility_tap_handler(const struct device *dev,
				const struct sensor_trigger *trigger)
{
	k_sem_give(&motion);
}

static void agility_update_filter(bool motion_is_detected)
{
	uint8_t filter;

	if (motion_is_detected) {
		filter = AGILITY_MOTION_FILTER;
		retained_mem_write(retmem, 0, &filter, 1);
	} else {
		retained_mem_read(retmem, 0, &filter, 1);

		if (filter > AGILITY_MOTION_FILTER) {
			/* Filter not initialized properly */
			filter = AGILITY_MOTION_FILTER;
		}

		if (filter > 0) {
			filter--;
			retained_mem_write(retmem, 0, &filter, 1);
		}
	}
}

static bool agility_is_moving(void)
{
	uint8_t filter;

	retained_mem_read(retmem, 0, &filter, 1);
	return filter > 0;
}

static void agility_routine(void)
{
	int ret;
	struct agility_message message;

	message.status = agility_is_moving() ? AGILITY_STATUS_MOVING : AGILITY_STATUS_STILL;
	zbus_chan_pub(&agility_channel, &message, K_SECONDS(1));

	ret = sensor_trigger_set(accelerometer, &motion_trigger, agility_tap_handler);
	if (ret < 0) {
		return;
	}

	while(true) {
		if (k_sem_take(&motion, AGILITY_MOTION_TIMEOUT) == 0) {
			agility_update_filter(true);
		} else {
			agility_update_filter(false);
		}

		if (agility_is_moving() && message.status == AGILITY_STATUS_STILL) {
			message.status = AGILITY_STATUS_MOVING;
			zbus_chan_pub(&agility_channel, &message, K_SECONDS(1));
		} else if (!agility_is_moving() && message.status == AGILITY_STATUS_MOVING) {
			message.status = AGILITY_STATUS_STILL;
			zbus_chan_pub(&agility_channel, &message, K_SECONDS(1));
		}
	}
}

K_THREAD_DEFINE(agility_thread, CONFIG_MAIN_STACK_SIZE, agility_routine, NULL, NULL, NULL,
		3, 0, 0);
```

## src/ambience.c
```c
#include <katja/ambience.h>
#include <zephyr/kernel.h>
#include <zephyr/drivers/rtc.h>

const struct device *rtc = DEVICE_DT_GET(DT_NODELABEL(rtc));
static struct rtc_time datetime;

static void ambience_routine(void)
{
	int ret;

	while (true) {
		ret = rtc_get_time(rtc, &datetime);
		if (ret < 0) {
			k_msleep(10020);
			continue;
		}

		printk("Time: %02u:%02u:%02u\n", datetime.tm_hour, datetime.tm_min,
		       datetime.tm_sec);
		k_msleep(10020);
	}
}

K_THREAD_DEFINE(ambience_thread, CONFIG_MAIN_STACK_SIZE, ambience_routine, NULL, NULL, NULL,
		3, 0, 0);
```

## src/channels.c
```c
#include <katja/epilogue.h>
#include <katja/agility.h>
#include <katja/persevere.h>
#include <katja/illuminate.h>
#include <katja/rhythmic.h>
#include <katja/conserve.h>
#include <katja/connection.h>

ZBUS_CHAN_DEFINE(
	persevere_channel,
	struct persevere_message,
	NULL,
	NULL,
	ZBUS_OBSERVERS(illuminate_subscriber, connection_subscriber),
	ZBUS_MSG_INIT(
		.charger_status = PERSEVERE_CHARGER_STATUS_DISCONNECTED,
		.battery_voltage = 0,
		.battery_capacity = 0,
	)
);

ZBUS_CHAN_DEFINE(
	agility_channel,
	struct agility_message,
	NULL,
	NULL,
	ZBUS_OBSERVERS(illuminate_subscriber),
	ZBUS_MSG_INIT(
		.status = AGILITY_STATUS_STILL,
	)
);

ZBUS_CHAN_DEFINE(
	rhythmic_channel,
	struct rhythmic_message,
	NULL,
	NULL,
	ZBUS_OBSERVERS(illuminate_subscriber),
	ZBUS_MSG_INIT(
		.beat = 0,
	)
);

ZBUS_CHAN_DEFINE(
	epilogue_channel,
	struct epilogue_message,
	NULL,
	NULL,
	ZBUS_OBSERVERS(epilogue_listener),
	ZBUS_MSG_INIT()
);

ZBUS_CHAN_DEFINE(
	conserve_channel,
	struct conserve_message,
	NULL,
	NULL,
	ZBUS_OBSERVERS(conserve_subscriber),
	ZBUS_MSG_INIT()
);

ZBUS_CHAN_DEFINE(
	connection_channel,
	struct connection_message,
	NULL,
	NULL,
	ZBUS_OBSERVERS(proxy_listener),
	ZBUS_MSG_INIT()
);
```

## src/connection.c
```c
#include <katja/connection.h>
#include <katja/persevere.h>
#include <katja/conserve.h>
#include <zephyr/kernel.h>
#include <zephyr/pm/device_runtime.h>
#include <zephyr/net/net_if.h>
#include <zephyr/net/net_mgmt.h>
#include <zephyr/net/net_event.h>
#include <zephyr/sys/atomic.h>

#define CONNECTION_IMPETUS_CHARGER_CONNECTED_BIT (0)

ZBUS_SUBSCRIBER_DEFINE(connection_subscriber, 4);

static const struct device *modem = DEVICE_DT_GET(DT_ALIAS(modem));
static atomic_t connection_impetuses = ATOMIC_INIT(0);
static struct conserve_message conserve_message;
static struct net_mgmt_event_callback connection_net_callback;
static bool modem_is_resumed;

static void connection_net_event_handler(struct net_mgmt_event_callback *cb, uint32_t mgmt_event,
					 struct net_if *iface)
{
	static struct connection_message message;

	ARG_UNUSED(cb);
	ARG_UNUSED(iface);

	if (mgmt_event == NET_EVENT_L4_CONNECTED) {
		message.cellular_status = CONNECTION_STATUS_CONNECTED;
		zbus_chan_pub(&connection_channel, &message, K_SECONDS(1));
	} else if (mgmt_event == NET_EVENT_L4_DISCONNECTED){
		message.cellular_status = CONNECTION_STATUS_DISCONNECTED;
		zbus_chan_pub(&connection_channel, &message, K_SECONDS(1));
	}
}

static void connection_handle_persevere_message(const struct zbus_channel *channel)
{
	struct persevere_message message;

	if (zbus_chan_read(channel, &message, K_MSEC(500))) {
		return;
	}

	if (message.charger_status != PERSEVERE_CHARGER_STATUS_DISCONNECTED) {
		atomic_set_bit(&connection_impetuses,
			       CONNECTION_IMPETUS_CHARGER_CONNECTED_BIT);
	} else {
		atomic_clear_bit(&connection_impetuses,
				 CONNECTION_IMPETUS_CHARGER_CONNECTED_BIT);
	}
}

static void connection_connect(void)
{
	if (modem_is_resumed) {
		return;
	}

	if (pm_device_runtime_get(modem) < 0) {
		return;
	}

	if (net_if_up(net_if_get_default()) < 0) {
		pm_device_runtime_put(modem);
		return;
	}

	conserve_message.event = CONSERVE_EVENT_REFERENCE;
	zbus_chan_pub(&conserve_channel, &conserve_message, K_SECONDS(1));
	modem_is_resumed = true;
}

static void connection_disconnect(void)
{
	if (!modem_is_resumed) {
		return;
	}

	if (net_if_down(net_if_get_default()) < 0) {
		return;
	}

	if (pm_device_runtime_put(modem) < 0) {
		return;
	}

	conserve_message.event = CONSERVE_EVENT_DEREFERENCE;
	zbus_chan_pub(&conserve_channel, &conserve_message, K_SECONDS(1));
	modem_is_resumed = false;
}

static void connection_init_net_callback(void)
{
	net_mgmt_init_event_callback(&connection_net_callback, connection_net_event_handler,
				     (NET_EVENT_L4_CONNECTED | NET_EVENT_L4_DISCONNECTED));
	net_mgmt_add_event_callback(&connection_net_callback);
}

static void connection_routine(void)
{
	const struct zbus_channel *channel;

	connection_init_net_callback();

	while (zbus_sub_wait(&connection_subscriber, &channel, K_FOREVER) == 0) {
		if (channel == &persevere_channel) {
			connection_handle_persevere_message(channel);
		}

		if (atomic_get(&connection_impetuses)) {
			connection_connect();
		} else {
			connection_disconnect();
		}
	}
}

K_THREAD_DEFINE(connection_thread, CONFIG_MAIN_STACK_SIZE, connection_routine, NULL, NULL, NULL,
		3, 0, 0);
```

## src/conserve.c
```c
#include <katja/conserve.h>
#include <katja/agility.h>
#include <katja/persevere.h>
#include <katja/epilogue.h>
#include <zephyr/sys/atomic.h>

ZBUS_SUBSCRIBER_DEFINE(conserve_subscriber, 4);

static atomic_t conserve_references = ATOMIC_INIT(0);

static void conserve_handle_conserve_message(const struct zbus_channel *channel)
{
	struct conserve_message message;

	if (zbus_chan_read(channel, &message, K_MSEC(500))) {
		return;
	}

	switch (message.event) {
	case CONSERVE_EVENT_REFERENCE:
		atomic_inc(&conserve_references);
		break;

	case CONSERVE_EVENT_DEREFERENCE:
		atomic_dec(&conserve_references);
		break;
	}
}

static bool conserve_uptime_exceeds_ms(uint32_t ms)
{
	return k_uptime_get() > ms;
}

static bool conserve_has_no_references(void)
{
	return atomic_get(&conserve_references) == 0;
}

static bool conserve_epilogue_is_imminent(void)
{
	if (conserve_uptime_exceeds_ms(200) &&
	    conserve_has_no_references()) {
		return true;
	}

	return false;
}

static bool conserve_is_still(void)
{
	struct agility_message message;

	if (zbus_chan_read(&agility_channel, &message, K_MSEC(500))) {
		return false;
	}

	return message.status == AGILITY_STATUS_STILL;
}

static void conserve_request_epilogue(void)
{
	struct epilogue_message message;

	if (conserve_is_still()) {
		message.await = EPILOGUE_AWAIT_MOVEMENT;
	} else {
		message.await = EPILOGUE_AWAIT_MOMENT;
	}

	zbus_chan_pub(&epilogue_channel, &message, K_SECONDS(1));
}

static void conserve_routine(void)
{
	const struct zbus_channel *channel;

	while (zbus_sub_wait(&conserve_subscriber, &channel, K_FOREVER) == 0) {
		if (channel == &conserve_channel) {
			conserve_handle_conserve_message(channel);
		}

		if (conserve_epilogue_is_imminent()) {
			conserve_request_epilogue();
			break;
		}
	}
}

K_THREAD_DEFINE(conserve_thread, CONFIG_MAIN_STACK_SIZE, conserve_routine, NULL, NULL, NULL,
		3, 0, 0);
```

## src/epilogue.c
```c
#include <katja/epilogue.h>
#include <katja/conserve.h>
#include <katja/persevere.h>

#include <zephyr/kernel.h>
#include <zephyr/sys/poweroff.h>
#include <zephyr/drivers/counter.h>

#include <zephyr/dt-bindings/power/atmel_sam_supc.h>
#include <soc.h>

#define EPILOGUE_MINIMUM_UPTIME_MS    (500)
#define EPILOGUE_MOMENT_MS            (1500)
#define EPILOGUE_MIN_BATTERY_CAPACITY (30)

static const struct device *counter = DEVICE_DT_GET(DT_ALIAS(wakeup_counter));

static void epilogue_counter_alarm_callback(const struct device *dev, uint8_t chan_id,
					    uint32_t ticks, void *user_data)
{

}

static void epilogue_set_counter_alarm(uint32_t period_ms)
{
	struct counter_alarm_cfg config = {
		.callback = epilogue_counter_alarm_callback,
		.ticks = counter_us_to_ticks(counter, (period_ms * 1000)),
		.user_data = NULL,
		.flags = 0,
	};

	counter_start(counter);
	counter_set_channel_alarm(counter, 0, &config);
}

static void epilogue_cancel_counter_alarm(void)
{
	counter_cancel_channel_alarm(counter, 0);
}

static bool epilogue_battery_capacity_is_low(void)
{
	const struct persevere_message *message;

	message = zbus_chan_const_msg(&persevere_channel);
	return message->battery_capacity < EPILOGUE_MIN_BATTERY_CAPACITY;
}

static void epilogue_await_charger(void)
{
	soc_supc_enable_wakeup_pin_source(1, SOC_SUPC_PIN_WKUP_TYPE_LOW);
}

static void epilogue_await_movement(void)
{
	soc_supc_enable_wakeup_pin_source(14, SOC_SUPC_PIN_WKUP_TYPE_HIGH);
}

static void epilogue_ignore_movement(void)
{
	soc_supc_disable_wakeup_pin_source(14);
}

static void epilogue_await_moment(void)
{
	soc_supc_enable_wakeup_source(SUPC_WAKEUP_SOURCE_RTT);
	epilogue_set_counter_alarm(EPILOGUE_MOMENT_MS);
}

static void epilogue_ignore_moment(void)
{
	epilogue_cancel_counter_alarm();
}

static void epilogue_callback(const struct zbus_channel *channel)
{
	const struct epilogue_message *message;
	uint32_t uptime_ms;

	if (channel != &epilogue_channel) {
		return;
	}

	/* Prevent immediate sleep as this prevents connecting a debugger */
	uptime_ms = k_uptime_get();
	if (uptime_ms < EPILOGUE_MINIMUM_UPTIME_MS) {
		k_msleep(EPILOGUE_MINIMUM_UPTIME_MS - uptime_ms);
	}

	message = zbus_chan_const_msg(channel);

	/* Always wake up if charger is connected */
	epilogue_await_charger();

	if (epilogue_battery_capacity_is_low()) {
		/* Prevent wakeup until charger is connected to protect battery */
		epilogue_ignore_movement();
		epilogue_ignore_moment();
		sys_poweroff();
	}

	if (message->await & EPILOGUE_AWAIT_MOVEMENT) {
		epilogue_await_movement();
	} else {
		epilogue_ignore_movement();
	}

	if (message->await & EPILOGUE_AWAIT_MOMENT) {
		epilogue_await_moment();
	} else {
		epilogue_ignore_moment();
	}

	sys_poweroff();
}

ZBUS_LISTENER_DEFINE(epilogue_listener, epilogue_callback);
```

## src/illuminate.c
```c
#include <zephyr/kernel.h>
#include <zephyr/device.h>
#include <zephyr/devicetree.h>
#include <zephyr/drivers/gpio.h>
#include <zephyr/drivers/led_strip.h>
#include <zephyr/drivers/led.h>
#include <katja/persevere.h>
#include <katja/agility.h>
#include <katja/conserve.h>
#include <katja/rhythmic.h>

#define ILLUMINATE_COLOR_MIN (10)
#define ILLUMINATE_PIXELS_SIZE (DT_PROP(DT_NODELABEL(led_strip), chain_length))

enum illuminate_shift_mode {
	ILLUMINATE_SHIFT_MODE_LTR = 0,
	ILLUMINATE_SHIFT_MODE_RTL,
	ILLUMINATE_SHIFT_MODE_SET,
	ILLUMINATE_SHIFT_MODE_EDGES,
	ILLUMINATE_SHIFT_MODE_CENTER,
};

enum illuminate_state {
	ILLUMINATE_STATE_DISCONNECTED = 0,
	ILLUMINATE_STATE_CHARGING,
	ILLUMINATE_STATE_CHARGED,
	ILLUMINATE_STATE_DISCONNECTING,
};

ZBUS_SUBSCRIBER_DEFINE(illuminate_subscriber, 4);

static const struct device *led_strip = DEVICE_DT_GET(DT_NODELABEL(led_strip));
static const struct gpio_dt_spec out1 = GPIO_DT_SPEC_GET(DT_PATH(zephyr_user), out1_gpios);
static struct led_rgb pixels[ILLUMINATE_PIXELS_SIZE];
static bool resumed;
static enum illuminate_state state = ILLUMINATE_STATE_DISCONNECTED;
static enum illuminate_state next_state = ILLUMINATE_STATE_DISCONNECTED;
static size_t beat = 0;
static size_t battery_capacity = 0;
static size_t charged_pixels_size = 0;
static bool conserve_referenced;

static void illuminate_resume(void)
{
	if (resumed) {
		return;
	}

	gpio_pin_configure_dt(&out1, GPIO_OUTPUT_ACTIVE);
	k_msleep(2);
	gpio_pin_configure_dt(&out1, GPIO_INPUT);
	resumed = true;
}

static void illuminate_suspend(void)
{
	if (!resumed) {
		return;
	}

	(void)gpio_pin_configure_dt(&out1, GPIO_OUTPUT_INACTIVE);
	resumed = false;
}

static bool illuminate_any_pixel_illuminating(void)
{
	for (size_t i = 0; i < ILLUMINATE_PIXELS_SIZE; i++) {
		if ((pixels[i].r > ILLUMINATE_COLOR_MIN) ||
		    (pixels[i].g > ILLUMINATE_COLOR_MIN) ||
		    (pixels[i].b > ILLUMINATE_COLOR_MIN))
		{
			return true;
		}
	}

	return false;
}

static void persevere_reference_conserve(void)
{
	if (conserve_referenced) {
		return;
	}

	conserve_publish_reference();
	conserve_referenced = true;
}

static void persevere_dereference_conserve(void)
{
	if (!conserve_referenced) {
		return;
	}

	conserve_publish_dereference();
	conserve_referenced = false;
}


static void illuminate_shift_pixels_ltr_range(const struct led_rgb *pixel, size_t start, size_t stop)
{
	if (stop > ILLUMINATE_PIXELS_SIZE) {
		stop = ILLUMINATE_PIXELS_SIZE;
	}

	if (stop <= start) {
		return;
	}

	for (size_t i = (stop - 1); i > start; i--) {
		pixels[i].r = pixels[i - 1].r;
		pixels[i].g = pixels[i - 1].g;
		pixels[i].b = pixels[i - 1].b;
	}

	pixels[start].r = pixel->r;
	pixels[start].g = pixel->g;
	pixels[start].b = pixel->b;
}

static inline void illuminate_shift_pixels_ltr(const struct led_rgb *pixel)
{
	illuminate_shift_pixels_ltr_range(pixel, 0, ILLUMINATE_PIXELS_SIZE);
}

static void illuminate_shift_pixels_rtl_range(const struct led_rgb *pixel, size_t start, size_t stop)
{
	if (stop > ILLUMINATE_PIXELS_SIZE) {
		stop = ILLUMINATE_PIXELS_SIZE;
	}

	if (stop <= start) {
		return;
	}

	for (size_t i = (ILLUMINATE_PIXELS_SIZE - stop); i < (ILLUMINATE_PIXELS_SIZE - 1 - start); i++) {
		pixels[i].r = pixels[i + 1].r;
		pixels[i].g = pixels[i + 1].g;
		pixels[i].b = pixels[i + 1].b;
	}

	pixels[ILLUMINATE_PIXELS_SIZE - 1 - start].r = pixel->r;
	pixels[ILLUMINATE_PIXELS_SIZE - 1 - start].g = pixel->g;
	pixels[ILLUMINATE_PIXELS_SIZE - 1 - start].b = pixel->b;
}

static inline void illuminate_shift_pixels_rtl(const struct led_rgb *pixel)
{
	illuminate_shift_pixels_rtl_range(pixel, 0, ILLUMINATE_PIXELS_SIZE);
}

static void illuminate_shift_pixels_set(const struct led_rgb *pixel)
{
	for (size_t i = 0; i < ILLUMINATE_PIXELS_SIZE; i++) {
		pixels[i].r = pixel->r;
		pixels[i].g = pixel->g;
		pixels[i].b = pixel->b;
	}
}

static inline bool illuminate_pixels_are_even(void)
{
	return (ILLUMINATE_PIXELS_SIZE % 2) == 0;
}

static void illuminate_shift_pixels_edges(const struct led_rgb *pixel)
{
	size_t halfsize = illuminate_pixels_are_even()
			? ILLUMINATE_PIXELS_SIZE / 2
			: (ILLUMINATE_PIXELS_SIZE / 2) + 1;

	illuminate_shift_pixels_rtl_range(pixel, 0, halfsize);
	illuminate_shift_pixels_ltr_range(pixel, 0, halfsize);
}

static void illuminate_shift_pixels_center(const struct led_rgb *pixel)
{
	size_t halfsize = ILLUMINATE_PIXELS_SIZE / 2;

	illuminate_shift_pixels_rtl_range(pixel, halfsize, ILLUMINATE_PIXELS_SIZE);
	illuminate_shift_pixels_ltr_range(pixel, halfsize, ILLUMINATE_PIXELS_SIZE);
}

static void illuminate_update_pixels(void)
{
	led_strip_update_rgb(led_strip, pixels, ARRAY_SIZE(pixels));
}

static size_t illuminate_pixel_size_by_percent(size_t percent)
{
	if (percent == 0) {
		return 0;
	}

	if (percent > 100) {
		return ILLUMINATE_PIXELS_SIZE;
	}

	return percent / (100 / ILLUMINATE_PIXELS_SIZE);
}

static void illuminate_disconnected_next(void)
{

}

static void illuminate_charging_next(void)
{
	charged_pixels_size = illuminate_pixel_size_by_percent(battery_capacity);
}

static void illuminate_charged_next(void)
{
	charged_pixels_size = ILLUMINATE_PIXELS_SIZE;
}

static void illuminate_disconnecting_next(void)
{

}

static void illuminate_next(void)
{
	state = next_state;
	beat = 0;

	switch (state) {
	case ILLUMINATE_STATE_DISCONNECTED:
		illuminate_disconnected_next();
		break;

	case ILLUMINATE_STATE_CHARGING:
		illuminate_charging_next();
		break;

	case ILLUMINATE_STATE_CHARGED:
		illuminate_charged_next();
		break;

	case ILLUMINATE_STATE_DISCONNECTING:
		illuminate_disconnecting_next();
		break;
	}
}

/*
static const struct led_rgb disconnected_warmup_wave_pixels[] = {
	{.r = 10, .g = 5},
	{.r = 15, .g = 7},
	{.r = 20, .g = 10},
	{.r = 25, .g = 13},
	{.r = 30, .g = 15},
	{.r = 35, .g = 17},
	{.r = 40, .g = 20},
	{.r = 45, .g = 23},
	{.r = 50, .g = 25},
};
*/

/*
static const struct led_rgb disconnected_pulse_wave_pixels[] = {
	{.r = 255, .g = 127},
	{.r = 205, .g = 103},
	{.r = 155, .g = 78},
	{.r = 105, .g = 53},
	{.r = 55, .g = 28},
};
*/

static const struct led_rgb disconnected_warmup_wave_pixels[] = {
	{.b = 10, .g = 10},
	{.b = 15, .g = 15},
	{.b = 20, .g = 20},
	{.b = 25, .g = 25},
	{.b = 30, .g = 30},
	{.b = 35, .g = 35},
	{.b = 40, .g = 40},
	{.b = 45, .g = 45},
	{.b = 50, .g = 50},
};

static const struct led_rgb disconnected_pulse_wave_pixels[] = {
	{.r = 255, .b = 127},
	{.r = 205, .b = 103},
	{.r = 155, .b = 78},
	{.r = 105, .b = 53},
	{.r = 55, .b = 28},
};

static const struct led_rgb disconnected_wave_pixel_off;

static void illuminate_disconnected_beat(void)
{
	const struct led_rgb *pixel;
	const size_t warmup_size = ARRAY_SIZE(disconnected_warmup_wave_pixels);
	const size_t pulse_size = ARRAY_SIZE(disconnected_pulse_wave_pixels);
	const size_t complete_size = warmup_size + pulse_size;

	if (beat < warmup_size) {
		pixel = &disconnected_warmup_wave_pixels[beat];
		illuminate_shift_pixels_set(pixel);
	} else if ((beat >= warmup_size) && (beat < complete_size)) {
		pixel = &disconnected_pulse_wave_pixels[beat - warmup_size];
		illuminate_shift_pixels_edges(pixel);
	} else {
		illuminate_shift_pixels_edges(&disconnected_wave_pixel_off);
	}
}

static const struct led_rgb charging_wave_pixels[] = {
	{.r = 10, .g = 40},
	{.r = 15, .g = 60},
	{.r = 30, .g = 115},
	{.r = 40, .g = 149},
	{.r = 45, .g = 180},
	{.r = 51, .g = 206},
	{.r = 55, .g = 227},
	{.r = 60, .g = 242},
	{.r = 62, .g = 251},
	{.r = 65, .g = 255},
	{.r = 65, .g = 255},
	{.r = 62, .g = 251},
	{.r = 60, .g = 242},
	{.r = 55, .g = 227},
	{.r = 51, .g = 206},
	{.r = 45, .g = 180},
	{.r = 40, .g = 149},
	{.r = 30, .g = 115},
	{.r = 15, .g = 60},
	{.r = 10, .g = 40},
};

static void illuminate_charging_beat(void)
{
	const struct led_rgb *pixel;

	if (beat < ARRAY_SIZE(charging_wave_pixels)) {
		pixel = &charging_wave_pixels[beat];
	} else {
		pixel = &charging_wave_pixels[ARRAY_SIZE(charging_wave_pixels) - 1];
	}

	illuminate_shift_pixels_ltr_range(pixel, 0, charged_pixels_size);
}

static void illuminate_charged_beat(void)
{
	const struct led_rgb *pixel;

	if (beat < ARRAY_SIZE(charging_wave_pixels)) {
		pixel = &charging_wave_pixels[beat];
	} else {
		pixel = &charging_wave_pixels[ARRAY_SIZE(charging_wave_pixels) - 1];
	}

	illuminate_shift_pixels_center(pixel);
}

static const struct led_rgb disconnecting_wave_pixels[] = {
	{.r = 10, .g = 40},
	{.r = 15, .g = 60},
	{.r = 30, .g = 115},
	{.r = 40, .g = 149},
	{.r = 45, .g = 180},
	{.r = 51, .g = 206},
	{.r = 55, .g = 227},
	{.r = 60, .g = 242},
	{.r = 62, .g = 251},
	{.r = 65, .g = 255},
	{.r = 65, .g = 255},
	{.r = 62, .g = 251},
	{.r = 60, .g = 242},
	{.r = 55, .g = 227},
	{.r = 51, .g = 206},
	{.r = 45, .g = 180},
	{.r = 40, .g = 149},
	{.r = 30, .g = 115},
	{.r = 15, .g = 60},
	{.r = 10, .g = 40},
};

static const struct led_rgb disconnecting_wave_pixel_off;

static void illuminate_disconnecting_beat(void)
{
	const struct led_rgb *pixel;

	if (beat < ARRAY_SIZE(charging_wave_pixels)) {
		pixel = &disconnecting_wave_pixels[beat];
	} else {
		pixel = &disconnecting_wave_pixel_off;
	}

	illuminate_shift_pixels_rtl_range(pixel, ILLUMINATE_PIXELS_SIZE - charged_pixels_size,
					  ILLUMINATE_PIXELS_SIZE);
}

static void illuminate_beat(void)
{
	switch (state) {
	case ILLUMINATE_STATE_DISCONNECTED:
		illuminate_disconnected_beat();
		break;

	case ILLUMINATE_STATE_CHARGING:
		illuminate_charging_beat();
		break;

	case ILLUMINATE_STATE_CHARGED:
		illuminate_charged_beat();
		break;

	case ILLUMINATE_STATE_DISCONNECTING:
		illuminate_disconnecting_beat();
		break;
	}

	if (illuminate_any_pixel_illuminating()) {
		persevere_reference_conserve();
		illuminate_resume();
		illuminate_update_pixels();

	} else {
		illuminate_update_pixels();
		illuminate_suspend();
		persevere_dereference_conserve();
	}

	beat++;
}

static inline bool illuminate_beat_is_next(size_t beat)
{
	return (beat % 80) == 0;
}

static void illuminate_handle_rhythmic_message(const struct zbus_channel *channel)
{
	struct rhythmic_message message;

	if (zbus_chan_read(channel, &message, K_MSEC(250))) {
		return;
	}

	if (illuminate_beat_is_next(message.beat)) {
		illuminate_next();
	}

	illuminate_beat();
}

static void illuminate_handle_persevere_message(const struct zbus_channel *channel)
{
	struct persevere_message message;

	if (zbus_chan_read(channel, &message, K_MSEC(250))) {
		return;
	}

	battery_capacity = message.battery_capacity;

	switch (state) {
	case ILLUMINATE_STATE_DISCONNECTED:
		switch (message.charger_status) {
			case PERSEVERE_CHARGER_STATUS_CHARGING:
				next_state = ILLUMINATE_STATE_CHARGING;
				break;
			case PERSEVERE_CHARGER_STATUS_CHARGED:
				next_state = ILLUMINATE_STATE_CHARGED;
				break;
			default:
				break;
		}

		break;

	case ILLUMINATE_STATE_CHARGING:
		switch (message.charger_status) {
			case PERSEVERE_CHARGER_STATUS_CHARGED:
			case PERSEVERE_CHARGER_STATUS_DISCONNECTED:
				next_state = ILLUMINATE_STATE_DISCONNECTING;
				break;
			default:
				break;
		}

		break;

	case ILLUMINATE_STATE_CHARGED:
		switch (message.charger_status) {
			case PERSEVERE_CHARGER_STATUS_CHARGING:
			case PERSEVERE_CHARGER_STATUS_DISCONNECTED:
				next_state = ILLUMINATE_STATE_DISCONNECTING;
				break;
			default:
				break;
		}

		break;

	case ILLUMINATE_STATE_DISCONNECTING:
		switch (message.charger_status) {
			case PERSEVERE_CHARGER_STATUS_CHARGING:
				next_state = ILLUMINATE_STATE_CHARGING;
				break;
			case PERSEVERE_CHARGER_STATUS_CHARGED:
				next_state = ILLUMINATE_STATE_CHARGED;
				break;
			case PERSEVERE_CHARGER_STATUS_DISCONNECTED:
				next_state = ILLUMINATE_STATE_DISCONNECTED;
				break;
		}

		break;
	}
}

static void illuminate_routine(void)
{
	const struct zbus_channel *channel;

	while (zbus_sub_wait(&illuminate_subscriber, &channel, K_FOREVER) == 0) {
		if (channel == &persevere_channel) {
			illuminate_handle_persevere_message(channel);
		}
		if (channel == &rhythmic_channel) {
			illuminate_handle_rhythmic_message(channel);
		}
	}
}

K_THREAD_DEFINE(illuminate_thread, CONFIG_MAIN_STACK_SIZE, illuminate_routine, NULL, NULL, NULL,
		3, 0, 0);
```

## src/persevere.c
```c
#include <katja/persevere.h>
#include <katja/conserve.h>
#include <zephyr/device.h>
#include <zephyr/drivers/gpio.h>
#include <zephyr/drivers/adc.h>
#include <zephyr/drivers/charger.h>
#include <zephyr/drivers/sensor.h>

#define PERSEVERE_BATTERY_MAX_MV (4150)
#define PERSEVERE_BATTERY_MIN_MV (3600)
#define PERSEVERE_BATTERY_MV_RANGE (PERSEVERE_BATTERY_MAX_MV - PERSEVERE_BATTERY_MIN_MV)
#define PERSEVERE_BATTERY_MV_PER_PERCENT (PERSEVERE_BATTERY_MV_RANGE / 100)

static const struct device *charger = DEVICE_DT_GET(DT_ALIAS(charger));
static const struct device *sensor = DEVICE_DT_GET(DT_ALIAS(battery_voltage_sensor));
static bool conserve_referenced;

static int persevere_get_charger_status(struct persevere_message *message)
{
	union charger_propval val;

	if (charger_get_prop(charger, CHARGER_PROP_STATUS, &val) < 0) {
		return -1;
	}

	switch (val.status) {
	case CHARGER_STATUS_CHARGING:
		message->charger_status = PERSEVERE_CHARGER_STATUS_CHARGING;
		break;

	case CHARGER_STATUS_DISCHARGING:
	case CHARGER_STATUS_NOT_CHARGING:
		message->charger_status = PERSEVERE_CHARGER_STATUS_DISCONNECTED;
		break;

	case CHARGER_STATUS_FULL:
		message->charger_status = PERSEVERE_CHARGER_STATUS_CHARGED;
		break;

	default:
		return -1;
	}

	return 0;
}

static int persevere_get_battery_voltage(struct persevere_message *message)
{
	struct sensor_value val;

	if (message->charger_status == PERSEVERE_CHARGER_STATUS_CHARGING) {
		charger_charge_enable(charger, false);
		k_msleep(10);
	}

	if (sensor_sample_fetch(sensor) < 0) {
		return -1;
	}

	if (message->charger_status == PERSEVERE_CHARGER_STATUS_CHARGING) {
		charger_charge_enable(charger, true);
	}

	if (sensor_channel_get(sensor, SENSOR_CHAN_VOLTAGE, &val) < 0) {
		return -1;
	}

	message->battery_voltage = (val.val1 * 1000) + (val.val2 / 1000);

	if (message->battery_voltage < 2800) {
		message->battery_voltage = 0;
	}

	return 0;
}

static void persevere_get_battery_capacity(struct persevere_message *message)
{
	if (message->battery_voltage < PERSEVERE_BATTERY_MIN_MV) {
		message->battery_capacity = 0;
		return;
	}

	message->battery_capacity = (message->battery_voltage - PERSEVERE_BATTERY_MIN_MV) /
				    (PERSEVERE_BATTERY_MV_PER_PERCENT);

	if (message->battery_capacity > 100) {
		message->battery_capacity = 100;
	}
}

static bool persevere_charger_is_connected(const struct persevere_message *message)
{
	return message->charger_status != PERSEVERE_CHARGER_STATUS_DISCONNECTED;
}

static void persevere_reference_conserve(void)
{
	if (conserve_referenced) {
		return;
	}

	conserve_publish_reference();
	conserve_referenced = true;
}

static void persevere_dereference_conserve(void)
{
	if (!conserve_referenced) {
		return;
	}

	conserve_publish_dereference();
	conserve_referenced = false;
}

static void persevere_routine(void)
{
	int ret;
	struct persevere_message message;

	while (true) {
		ret = persevere_get_charger_status(&message);
		if (ret < 0) {
			continue;
		}

		if (persevere_charger_is_connected(&message)) {
			persevere_reference_conserve();
		} else {
			persevere_dereference_conserve();
		}

		ret = persevere_get_battery_voltage(&message);
		if (ret < 0) {
			continue;
		}

		persevere_get_battery_capacity(&message);

		zbus_chan_pub(&persevere_channel, &message, K_SECONDS(1));
		k_msleep(1000);
	}
}

K_THREAD_DEFINE(persevere_thread, CONFIG_MAIN_STACK_SIZE, persevere_routine, NULL, NULL, NULL,
		3, 0, 0);
```

## src/proxy.c
```c
#include <katja/proxy.h>
#include <katja/connection.h>
#include <zephyr/kernel.h>
#include <zephyr/net/net_if.h>
#include <zephyr/net/net_ip.h>
#include <zephyr/net/socket.h>

#define SAMPLE_PROXY_IPV4_ADDR_BYTES	(139, 177, 179, 5)
#define SAMPLE_PROXY_SMP_PROXY_PORT	(10007)
#define SAMPLE_PROXY_SMP_LOCAL_PORT	(CONFIG_MCUMGR_TRANSPORT_UDP_PORT)

static K_SEM_DEFINE(proxy_net_connected_sem, 0, 1);
static uint8_t recv_buf[1500];
static struct sockaddr proxy_smp_ai_addr;
static socklen_t proxy_smp_ai_addrlen;
static struct sockaddr local_smp_ai_addr;
static socklen_t local_smp_ai_addrlen;
static struct sockaddr recv_ai_addr;
static socklen_t recv_ai_addrlen;

static void proxy_init_sockaddr(void)
{
	net_sin(&proxy_smp_ai_addr)->sin_family = AF_INET;
	net_sin(&proxy_smp_ai_addr)->sin_port = htons(SAMPLE_PROXY_SMP_PROXY_PORT);
	net_sin(&proxy_smp_ai_addr)->sin_addr.s4_addr[0] = 139;
	net_sin(&proxy_smp_ai_addr)->sin_addr.s4_addr[1] = 177;
	net_sin(&proxy_smp_ai_addr)->sin_addr.s4_addr[2] = 179;
	net_sin(&proxy_smp_ai_addr)->sin_addr.s4_addr[3] = 5;
	proxy_smp_ai_addrlen = sizeof(struct sockaddr_in);

	net_sin(&local_smp_ai_addr)->sin_family = AF_INET;
	net_sin(&local_smp_ai_addr)->sin_port = htons(SAMPLE_PROXY_SMP_LOCAL_PORT);
	net_sin(&local_smp_ai_addr)->sin_addr.s4_addr[0] = 127;
	net_sin(&local_smp_ai_addr)->sin_addr.s4_addr[1] = 0;
	net_sin(&local_smp_ai_addr)->sin_addr.s4_addr[2] = 0;
	net_sin(&local_smp_ai_addr)->sin_addr.s4_addr[3] = 1;
	local_smp_ai_addrlen = sizeof(struct sockaddr_in);
}

static bool proxy_sockaddr_is_identical(const struct sockaddr* ai_addr1,
					const struct sockaddr* ai_addr2)
{
	return memcmp(ai_addr1, ai_addr2, sizeof(struct sockaddr_in)) == 0;
}

static void proxy_callback(const struct zbus_channel *channel)
{
	const struct connection_message *message;

	message = zbus_chan_const_msg(channel);

	if (message->cellular_status == CONNECTION_STATUS_CONNECTED) {
		k_sem_give(&proxy_net_connected_sem);
	}
}

ZBUS_LISTENER_DEFINE(proxy_listener, proxy_callback);

static void proxy_run_proxy(void)
{
	int sock_smp;
	int ret;

	printk("Opening sockets\n");
	sock_smp = zsock_socket(AF_INET, SOCK_DGRAM, IPPROTO_UDP);
	if (sock_smp < 0) {
		printk("Failed to open smp socket\n");
		return;
	}

	printk("Register sockets\n");
	ret = zsock_sendto(sock_smp, "h", 1, 0,
			   &proxy_smp_ai_addr, proxy_smp_ai_addrlen);
	if (ret < 0) {
		printk("Failed to register socket\n");
		return;
	}

	printk("Polling socket\n");
	while (true) {
		recv_ai_addrlen = sizeof(recv_ai_addr);
		ret = zsock_recvfrom(sock_smp, recv_buf, sizeof(recv_buf), 0,
					&recv_ai_addr, &recv_ai_addrlen);
		if (proxy_sockaddr_is_identical(&recv_ai_addr, &proxy_smp_ai_addr)) {
			zsock_sendto(sock_smp, recv_buf, (size_t)ret, 0,
					&local_smp_ai_addr, local_smp_ai_addrlen);
		} else {
			zsock_sendto(sock_smp, recv_buf, (size_t)ret, 0,
					&proxy_smp_ai_addr, proxy_smp_ai_addrlen);
		}
	}
}

static void proxy_routine(void)
{
	proxy_init_sockaddr();

	k_sem_take(&proxy_net_connected_sem, K_FOREVER);

	proxy_run_proxy();
}

K_THREAD_DEFINE(proxy_thread, CONFIG_MAIN_STACK_SIZE, proxy_routine, NULL, NULL, NULL,
		3, 0, 0);
```

## src/rhythmic.c
```c
#include <katja/rhythmic.h>
#include <zephyr/kernel.h>

static struct rhythmic_message message;

static void rhythmic_timer_expired(struct k_timer *timer_id)
{
	zbus_chan_pub(&rhythmic_channel, &message, K_MSEC(35));
	message.beat++;
}

K_TIMER_DEFINE(rhythmic_timer, rhythmic_timer_expired, NULL);

static int rhythmic_init(void)
{
	k_timer_start(&rhythmic_timer, K_NO_WAIT, K_MSEC(35));
	return 0;
}

SYS_INIT(rhythmic_init, APPLICATION, 99);
```
